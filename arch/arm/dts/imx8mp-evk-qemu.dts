// SPDX-License-Identifier: (GPL-2.0 OR MIT)

#include "imx8mp-evk.dts"

/* QEMU doesn't emulate the DDRC, so disable and rely on the memory node it provides instead */
&edacmc {
	status = "disabled";
};
