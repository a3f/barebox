## arch/arm/configs/rgb30_defconfig
```kconfig
CONFIG_ARCH_ROCKCHIP=y
CONFIG_MACH_RK3568_BPI_R2PRO=y
CONFIG_MACH_PINE64_PINETAB2=y
CONFIG_MACH_PINE64_QUARTZ64=y
CONFIG_MACH_PROTONIC_MECSBC=y
CONFIG_MACH_ANBERNIC_RGXX3=y
CONFIG_64BIT=y
CONFIG_ARM_PSCI_CLIENT=y
CONFIG_BOARD_GENERIC_FIT=y
CONFIG_IMAGE_COMPRESSION_XZKERN=y
CONFIG_MMU=y
CONFIG_MALLOC_SIZE=0x0
CONFIG_KALLSYMS=y
CONFIG_PROMPT="barebox> "
CONFIG_BAUDRATE=1500000
CONFIG_HUSH_FANCY_PROMPT=y
CONFIG_CMDLINE_EDITING=y
CONFIG_AUTO_COMPLETE=y
CONFIG_BOOTM_SHOW_TYPE=y
CONFIG_BOOTM_VERBOSE=y
CONFIG_BOOTM_INITRD=y
CONFIG_BOOTM_AIMAGE=y
CONFIG_BLSPEC=y
CONFIG_MMCBLKDEV_ROOTARG=y
CONFIG_CONSOLE_ALLOW_COLOR=y
CONFIG_PBL_CONSOLE=y
CONFIG_PARTITION_DISK_EFI=y
CONFIG_DEFAULT_ENVIRONMENT_GENERIC_NEW=y
CONFIG_STATE=y
CONFIG_BOOTCHOOSER=y
CONFIG_RESET_SOURCE=y
CONFIG_DEBUG_LL=y
CONFIG_DEBUG_PBL=y
CONFIG_KASAN=y
CONFIG_CMD_CLASS=y
CONFIG_CMD_DMESG=y
CONFIG_LONGHELP=y
CONFIG_CMD_IOMEM=y
CONFIG_CMD_IMD=y
CONFIG_CMD_MEMINFO=y
CONFIG_CMD_BLKSTATS=y
CONFIG_CMD_REGULATOR=y
CONFIG_CMD_PM_DOMAIN=y
CONFIG_CMD_VARINFO=y
CONFIG_CMD_BFETCH=y
CONFIG_CMD_GO=y
CONFIG_CMD_RESET=y
CONFIG_CMD_UIMAGE=y
CONFIG_CMD_BOOTCHOOSER=y
CONFIG_CMD_PARTITION=y
CONFIG_CMD_FINDMNT=y
CONFIG_CMD_PARTED=y
CONFIG_CMD_EXPORT=y
CONFIG_CMD_DEFAULTENV=y
CONFIG_CMD_LOADENV=y
CONFIG_CMD_PRINTENV=y
CONFIG_CMD_MAGICVAR=y
CONFIG_CMD_MAGICVAR_HELP=y
CONFIG_CMD_SAVEENV=y
CONFIG_CMD_FILETYPE=y
CONFIG_CMD_LN=y
CONFIG_CMD_MD5SUM=y
CONFIG_CMD_SHA1SUM=y
CONFIG_CMD_SHA224SUM=y
CONFIG_CMD_SHA256SUM=y
CONFIG_CMD_UNCOMPRESS=y
CONFIG_CMD_LET=y
CONFIG_CMD_MSLEEP=y
CONFIG_CMD_READF=y
CONFIG_CMD_SLEEP=y
CONFIG_CMD_DHCP=y
CONFIG_CMD_MIITOOL=y
CONFIG_CMD_PING=y
CONFIG_CMD_TFTP=y
CONFIG_CMD_ECHO_E=y
CONFIG_CMD_EDIT=y
CONFIG_CMD_SPLASH=y
CONFIG_CMD_FBTEST=y
CONFIG_CMD_READLINE=y
CONFIG_CMD_TIMEOUT=y
CONFIG_CMD_MM=y
CONFIG_CMD_CLK=y
CONFIG_CMD_DETECT=y
CONFIG_CMD_SYNC=y
CONFIG_CMD_GPIO=y
CONFIG_CMD_I2C=y
CONFIG_CMD_LED=y
CONFIG_CMD_SMC=y
CONFIG_CMD_MIPI_DSI=y
CONFIG_CMD_USBGADGET=y
CONFIG_CMD_WD=y
CONFIG_CMD_BAREBOX_UPDATE=y
CONFIG_CMD_OF_DIFF=y
CONFIG_CMD_OF_NODE=y
CONFIG_CMD_OF_PROPERTY=y
CONFIG_CMD_OF_DISPLAY_TIMINGS=y
CONFIG_CMD_OFTREE=y
CONFIG_CMD_TIME=y
CONFIG_CMD_WATCH=y
CONFIG_NET=y
CONFIG_DEEP_PROBE_DEFAULT=y
CONFIG_OF_BAREBOX_DRIVERS=y
CONFIG_AIODEV=y
CONFIG_ROCKCHIP_SARADC=y
CONFIG_DRIVER_SERIAL_NS16550=y
CONFIG_DRIVER_NET_DESIGNWARE_ROCKCHIP=y
CONFIG_REALTEK_PHY=y
CONFIG_SMSC_PHY=y
CONFIG_NET_USB=y
CONFIG_NET_USB_ASIX=y
CONFIG_USB_NET_AX88179_178A=y
CONFIG_NET_USB_SMSC95XX=y
CONFIG_NET_USB_RTL8152=y
CONFIG_SPI_ROCKCHIP=y
CONFIG_I2C=y
CONFIG_I2C_GPIO=y
CONFIG_I2C_RK3X=y
CONFIG_USB_HOST=y
CONFIG_USB_DWC3=y
CONFIG_USB_DWC3_DUAL_ROLE=y
CONFIG_USB_STORAGE=y
CONFIG_USB_ONBOARD_DEV=y
CONFIG_USB_GADGET=y
CONFIG_USB_GADGET_DFU=y
CONFIG_USB_GADGET_SERIAL=y
CONFIG_USB_GADGET_FASTBOOT=y
CONFIG_USB_GADGET_MASS_STORAGE=y
CONFIG_VIDEO=y
CONFIG_FRAMEBUFFER_CONSOLE=y
CONFIG_DRIVER_VIDEO_ROCKCHIP=y
CONFIG_DRIVER_VIDEO_ROCKCHIP_VOP2=y
CONFIG_DRIVER_VIDEO_ROCKCHIP_HDMI=y
CONFIG_DRIVER_VIDEO_ROCKCHIP_MIPI_DSI=y
CONFIG_DRIVER_VIDEO_BACKLIGHT=y
CONFIG_DRIVER_VIDEO_BACKLIGHT_PWM=y
CONFIG_DRIVER_VIDEO_PANEL_SITRONIX_ST7789V=y
CONFIG_DRIVER_VIDEO_PANEL_SITRONIX_ST7703=y
CONFIG_MCI=y
CONFIG_MCI_ROCKCHIP_DWCMSHC=y
CONFIG_MCI_ARASAN=y
CONFIG_COMMON_CLK_SCMI=y
CONFIG_MFD_ACT8846=y
CONFIG_MFD_RK808=y
CONFIG_LED=y
CONFIG_LED_GPIO=y
CONFIG_LED_PWM=y
CONFIG_LED_GPIO_OF=y
CONFIG_EEPROM_AT25=y
CONFIG_EEPROM_AT24=y
CONFIG_WATCHDOG=y
CONFIG_WATCHDOG_POLLER=y
CONFIG_WATCHDOG_DW=y
CONFIG_PWM=y
CONFIG_PWM_ROCKCHIP=y
CONFIG_HWRNG=y
CONFIG_HW_RANDOM_OPTEE=y
CONFIG_HW_RANDOM_ROCKCHIP=y
CONFIG_NVMEM_ROCKCHIP_OTP=y
CONFIG_REGULATOR=y
CONFIG_REGULATOR_FIXED=y
CONFIG_REGULATOR_ARM_SCMI=y
CONFIG_REGULATOR_RK808=y
CONFIG_ARM_SCMI_PROTOCOL=y
CONFIG_USB_NOP_XCEIV=y
CONFIG_PHY_ROCKCHIP_INNO_DSIDPHY=y
CONFIG_PHY_ROCKCHIP_INNO_USB2=y
CONFIG_PHY_ROCKCHIP_NANENG_COMBO_PHY=y
CONFIG_PHY_ROCKCHIP_SNPS_PCIE3=y
CONFIG_PHY_ROCKCHIP_USBDP=y
CONFIG_ROCKCHIP_IODOMAIN=y
CONFIG_ROCKCHIP_PM_DOMAINS=y
# CONFIG_VIRTIO_MENU is not set
CONFIG_TEE=y
CONFIG_OPTEE=y
CONFIG_FS_EXT4=y
CONFIG_FS_TFTP=y
CONFIG_FS_TFTP_MAX_WINDOW_SIZE=128
CONFIG_FS_NFS=y
CONFIG_FS_FAT=y
CONFIG_FS_FAT_WRITE=y
CONFIG_FS_SQUASHFS=y
CONFIG_PBL_OPTEE=y
# CONFIG_STACK_GUARD_PAGE is not set
CONFIG_LZ4_DECOMPRESS=y
CONFIG_LZO_DECOMPRESS=y
CONFIG_FONT_8x16=y
CONFIG_FONT_7x14=y
CONFIG_FONT_TER16x32=y
CONFIG_BAREBOX_LOGO=y
CONFIG_BAREBOX_LOGO_640=y
# CONFIG_MISSING_FIRMWARE_ERROR is not set
CONFIG_RK_USB_LOADER=y
```

## arch/arm/mach-mediatek/Kconfig
```kconfig
# SPDX-License-Identifier: GPL-2.0-only

menu "Mediatek SoCs"
        depends on ARCH_MEDIATEK

config ARCH_MEDIATEK_V8
	bool
	select CPU_V8
	select CPU_SUPPORTS_64BIT_KERNEL
	select CLOCKSOURCE_ARM_ARCHITECTED_TIMER
	select CHROME_PLATFORMS

config ARCH_MT8186
	bool "Mediatek mt98186 SoC"
	select ARCH_MEDIATEK_V8
	depends on 64BIT
	default y

endmenu
```

## arch/arm/mach-stm32mp/Kconfig
```kconfig
# SPDX-License-Identifier: GPL-2.0-only

if ARCH_STM32MP

config ARCH_NR_GPIO
	int
	default 416

config ARCH_STM32MP1
	bool
	select CPU_V7

config ARCH_STM32MP2
	bool
	select CPU_V8

config ARCH_STM32MP13
	select ARM_PSCI_CLIENT
	bool
	select ARCH_STM32MP1

config ARCH_STM32MP157
	select ARM_PSCI_CLIENT
	bool
	select ARCH_STM32MP1

config ARCH_STM32MP257
	select ARM_PSCI_CLIENT
	bool
	select ARCH_STM32MP2

config MACH_STM32MP13XX_DK
	select ARCH_STM32MP13
	bool "STM32MP135F DK board"
	depends on 32BIT

config MACH_STM32MP15XX_DKX
	select ARCH_STM32MP157
	bool "STM32MP157 DK1 and DK2 boards"
	depends on 32BIT
	help
	  builds a single barebox-stm32mp15xx-dkx.stm32 that can be deployed
	  as SSBL on both the stm32mp157a-dk1 and stm32mp157c-dk2

config MACH_LXA_MC1
	select ARCH_STM32MP157
	bool "Linux Automation MC-1 board"
	depends on 32BIT

config MACH_SEEED_ODYSSEY
	select ARCH_STM32MP157
	bool "Seeed Studio Odyssey"
	depends on 32BIT

config MACH_STM32MP15X_EV1
	select ARCH_STM32MP157
	bool "STM32MP15X-EV1 board"
	depends on 32BIT
	help
	  builds a single barebox-stm32mp15x-ev1.stm32 that can be deployed
	  as SSBL on any STM32MP15X-EVAL platform, like the
	  STM32MP157C-EV1

config MACH_PROTONIC_STM32MP1
	select ARCH_STM32MP157
	bool "Protonic PRTT1L family of boards"
	depends on 32BIT
	help
	  Builds all barebox-prtt1*.stm32 that can be deployed as SSBL
	  on the respective PRTT1L family board

config MACH_PHYTEC_PHYCORE_STM32MP1
	select ARCH_STM32MP157
	bool "phyCORE-STM32MP1"
	depends on 32BIT
	help
	  builds an additional barebox-phytec-phycore.stm32
	  that can be deployed as SSBL on the phyCORE-STM32MP1

config MACH_STM32MP25X_EV1
	select ARCH_STM32MP257
	bool "STM32MP25X-EV1 board"
	depends on 64BIT
	help
	  FIXME

endif
```

## arch/x86/configs/efi_minimal_defconfig
```kconfig
CONFIG_NAME="efi_defconfig"
CONFIG_GLOBALVAR=y
CONFIG_MMU=y
CONFIG_SHELL_NONE=y
CONFIG_GLOB_SORT=y
# CONFIG_ERRNO_MESSAGES is not set
CONFIG_BOOTM_VERBOSE=y
CONFIG_BOOTM_INITRD=y
# CONFIG_BOOTM_UIMAGE is not set
CONFIG_FLEXIBLE_BOOTARGS=y
CONFIG_IMD=y
CONFIG_CONSOLE_NONE=y
# CONFIG_CONSOLE_DISABLE_INPUT is not set
# CONFIG_PARTITION_DISK_DOS is not set
CONFIG_ENV_HANDLING=y
# CONFIG_ENV_HANDLING_AUTOPROBE is not set
CONFIG_POLLER=y
CONFIG_STATE=y
CONFIG_BOOTCHOOSER=y
# CONFIG_FILETYPE_STRINGS is not set
CONFIG_DEBUG_LL=y
CONFIG_EFI_PAYLOAD_BOOTM=y
# CONFIG_EFI_GUID_STRINGS is not set
# CONFIG_SPI is not set
CONFIG_DISK=y
CONFIG_DISK_WRITE=y
CONFIG_VIDEO=y
CONFIG_DRIVER_VIDEO_EFI_GOP=y
CONFIG_FINTEK_SUPERIO=y
CONFIG_SMSC_SUPERIO=y
CONFIG_DEV_MEM=y
CONFIG_WATCHDOG=y
CONFIG_WATCHDOG_EFI=y
CONFIG_F71808E_WDT=y
# CONFIG_VIRTIO_MENU is not set
# CONFIG_FS_RAMFS is not set
# CONFIG_FS_DEVFS is not set
CONFIG_FS_EFI=y
CONFIG_FS_EFIVARFS=y
```

## drivers/base/Kconfig
```kconfig
# SPDX-License-Identifier: GPL-2.0-only

config PM_GENERIC_DOMAINS
	bool

config FEATURE_CONTROLLER
	bool "Feature controller support" if COMPILE_TEST || SANDBOX

config SOC_BUS
	bool

config FAUX_BUS
	bool "Faux bus suppport" if COMPILE_TEST
	help
	  The "simple" faux bus that allows devices to be created and added
	  automatically to it.  This is to be used whenever you need to create a
	  device that is not associated with any "real" system resources, and do
	  not want to have to deal with a bus/driver binding logic.  It is
	  intended to be very simple, with only a create and a destroy function
	  available.

source "drivers/base/regmap/Kconfig"
```

## drivers/pinctrl/mediatek/Kconfig
```kconfig
# SPDX-License-Identifier: GPL-2.0-only
menu "MediaTek pinctrl drivers"
	depends on ARCH_MEDIATEK || COMPILE_TEST

config PINCTRL_MTK_V2
	tristate

config PINCTRL_MTK_PARIS
	tristate
	depends on OF
	select PINMUX
	select GENERIC_PINCONF
	select GPIOLIB
	select PINCTRL_MTK_V2

config PINCTRL_MT8186
	bool "MediaTek MT8186 pin control"
	depends on OF
	depends on ARM64 || COMPILE_TEST
	default ARM64 && ARCH_MEDIATEK
	select PINCTRL_MTK_PARIS

endmenu
```

## drivers/platform/Kconfig
```kconfig
# SPDX-License-Identifier: GPL-2.0-only

source "drivers/platform/chrome/Kconfig"
```

## drivers/platform/chrome/Kconfig
```kconfig
# SPDX-License-Identifier: GPL-2.0-only
#
# Platform support for Chrome OS hardware (Chromebooks and Chromeboxes)
#

menuconfig CHROME_PLATFORMS
	bool "Platform support for Chrome hardware"
	depends on ARM64 || COMPILE_TEST
	help
	  Say Y here to get to see options for platform support for
	  various Chromebooks and Chromeboxes. This option alone does
	  not add any kernel code.

	  If you say N, all options in this submenu will be skipped and disabled.

if CHROME_PLATFORMS

config CROS_EC
	tristate "ChromeOS Embedded Controller"
	select CROS_EC_PROTO
	depends on ARM64 || COMPILE_TEST
	help
	  If you say Y here you get support for the ChromeOS Embedded
	  Controller (EC) providing keyboard, battery and power services.
	  You also need to enable the driver for the bus you are using. The
	  protocol for talking to the EC is defined by the bus driver.

config CROS_EC_SPI
	tristate "ChromeOS Embedded Controller (SPI)"
	depends on CROS_EC && SPI
	help
	  If you say Y here, you get support for talking to the ChromeOS EC
	  through a SPI bus, using a byte-level protocol. Since the EC's
	  response time cannot be guaranteed, we support ignoring
	  'pre-amble' bytes before the response actually starts.

config CROS_EC_PROTO
	tristate
	help
	  ChromeOS EC communication protocol helpers.

endif # CHROMEOS_PLATFORMS
```

## drivers/video/rockchip/Kconfig
```kconfig
config DRIVER_VIDEO_ROCKCHIP
	bool "Rockchip framebuffer drivers"

if DRIVER_VIDEO_ROCKCHIP

config DRIVER_VIDEO_ROCKCHIP_VOP2
        bool "Rockchip vop2 framebuffer driver"
        select VIDEO_VPL
        select OFTREE

config DRIVER_VIDEO_ROCKCHIP_HDMI
        bool "Rockchip HDMI driver"
        select VIDEO_VPL
        select OFTREE
        select DRIVER_VIDEO_EDID
        select DRIVER_VIDEO_DW_HDMI
        help
          Say y here if you want to use HDMI on RK356x based SoCs

config DRIVER_VIDEO_ROCKCHIP_HDMI_QP
        bool "Rockchip HDMI QP driver"
        select VIDEO_VPL
        select OFTREE
        select DRIVER_VIDEO_EDID
        select DRIVER_VIDEO_DW_HDMI
        help
          Say y here if you want to use HDMI on RK3588 based SoCs

config DRIVER_VIDEO_ROCKCHIP_MIPI_DSI
        bool "Rockchip MIPI-DSI driver"
        select VIDEO_VPL
        select OFTREE
        select DRIVER_VIDEO_DW_MIPI_DSI
        select GENERIC_PHY
        select GENERIC_PHY_MIPI_DPHY

config DRIVER_VIDEO_ROCKCHIP_MIPI_DSI2
        bool "Rockchip MIPI-DSI2 driver"
        select VIDEO_VPL
        select OFTREE
        select DRIVER_VIDEO_DW_MIPI_DSI2
        select GENERIC_PHY
        select GENERIC_PHY_MIPI_DPHY

endif
```

## efi/loader/Kconfig
```kconfig
# SPDX-License-Identifier: GPL-2.0-only

config EFI_LOADER_DEBUG_SUPPORT
	bool "EFI Debug Support"
	default y
	help
	  Select this option if you want to setup the EFI Debug Support
	  Table and the EFI_SYSTEM_TABLE_POINTER which is used by the debug
	  agent or an external debugger to determine loaded image information
	  in a quiescent manner.

menu "UEFI services"

config EFI_LOADER_GET_TIME
	bool "GetTime() runtime service"
	depends on RTC_CLASS
	default y
	help
	  Provide the GetTime() runtime service at boottime. This service
	  can be used by an EFI application to read the real time clock.

config EFI_LOADER_SET_TIME
	bool "SetTime() runtime service"
	depends on RTC_CLASS
	default y
	help
	  Provide the SetTime() runtime service at boottime. This service
	  can be used by an EFI application to adjust the real time clock.

endmenu

source "efi/loader/protocols/Kconfig"
```

## security/Kconfig
```kconfig
# SPDX-License-Identifier: GPL-2.0-only
#
# Security configuration
#

menu "Security options"

source "security/Kconfig.policy"

endmenu
```
