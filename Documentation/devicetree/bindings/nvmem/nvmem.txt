## lib/Kconfig.hardening
```kconfig
menu "Hardening options"

config BUG_ON_DATA_CORRUPTION
	bool "Trigger a BUG when data corruption is detected"
	select DEBUG_LIST
	help
	  Select this option if barebox should BUG when it encounters
	  data corruption in its memory structures when they get checked
	  for validity.

	  If unsure, say N.

menu "Memory initialization"

config INIT_ON_ALLOC_DEFAULT_ON
	bool "Enable heap memory zeroing on allocation by default"
	help
	  This has the effect of setting "init_on_alloc=1" on the kernel
	  command line. This can be disabled with "init_on_alloc=0".
	  When "init_on_alloc" is enabled, all page allocator and slab
	  allocator memory will be zeroed when allocated, eliminating
	  many kinds of "uninitialized heap memory" flaws, especially
	  heap content exposures. The performance impact varies by
	  workload, but most cases see <1% impact. Some synthetic
	  workloads have measured as high as 7%.

config INIT_ON_FREE_DEFAULT_ON
	bool "Enable heap memory zeroing on free by default"
	depends on !MALLOC_DUMMY
	help
	  This has the effect of setting "init_on_free=1" on the kernel
	  command line. This can be disabled with "init_on_free=0".
	  Similar to "init_on_alloc", when "init_on_free" is enabled,
	  all page allocator and slab allocator memory will be zeroed
	  when freed, eliminating many kinds of "uninitialized heap memory"
	  flaws, especially heap content exposures. The primary difference
	  with "init_on_free" is that data lifetime in memory is reduced,
	  as anything freed is wiped immediately, making live forensics or
	  cold boot memory attacks unable to recover freed memory contents.
	  The performance impact varies by workload, but is more expensive
	  than "init_on_alloc" due to the negative cache effects of
	  touching "cold" memory areas. Most cases see 3-5% impact. Some
	  synthetic workloads have measured as high as 8%.

endmenu

menu "Buffer overflow protection"

config FORTIFY_SOURCE
	bool "Harden common str/mem functions against buffer overflows"
	depends on ARCH_HAS_FORTIFY_SOURCE
	# https://bugs.llvm.org/show_bug.cgi?id=41459
	depends on !CC_IS_CLANG || CLANG_VERSION >= 120001
	# https://github.com/llvm/llvm-project/issues/53645
	depends on !CC_IS_CLANG || !X86_32
	help
	  Detect overflows of buffers in common string and memory functions
	  where the compiler can determine and validate the buffer sizes.

config STACK_GUARD_PAGE
	bool "Place guard page to catch stack overflows"
	depends on ARM && MMU
	help
	  When enabled, barebox places a faulting guard page to catch total
	  stack usage exceeding CONFIG_STACK_SIZE. On overflows, that hit
	  the reserved 4KiB, barebox will panic and report a stack overflow.
	  The report may not always succeed if the stack overflow impacts
	  operation of the exception handler.

config STACKPROTECTOR
	bool

choice
	prompt "Stack Protector buffer overflow detection"

config STACKPROTECTOR_NONE
	bool "None"

config STACKPROTECTOR_STRONG
	bool "Strong"
	depends on $(cc-option,-fstack-protector-strong)
	select STACKPROTECTOR
	help
	  This option turns on the "stack-protector" GCC feature. This
	  feature puts, at the beginning of functions, a canary value on
	  the stack just before the return address, and validates
	  the value just before actually returning.  Stack based buffer
	  overflows (that need to overwrite this return address) now also
	  overwrite the canary, which gets detected and the attack is then
	  neutralized via a barebox panic.

	  Functions will have the stack-protector canary logic added in any
	  of the following conditions:

	  - local variable's address used as part of the right hand side of an
	    assignment or function argument
	  - local variable is an array (or union containing an array),
	    regardless of array type or length
	  - uses register local variables

	  The canary will be a fixed value at first, but will be replaced by
	  one generated from a hardware random number generator if available
	  later on.

config STACKPROTECTOR_ALL
	bool "All"
	depends on $(cc-option,-fstack-protector-all)
	depends on COMPILE_TEST
	select STACKPROTECTOR
	help
	  This pushes and verifies stack protector canaries on all functions,
	  even those that don't need it. As this implies injection of a
	  global variable dependency on every function, this option is useful
	  for crashing functions called prior to prerelocation, which lack a
	  __prereloc attribute. This is likely the only upside compared to
	  the strong variant, so it's not selectable by default.

endchoice

choice
	prompt "Stack Protector buffer overflow detection for PBL" if PBL_IMAGE

config PBL_STACKPROTECTOR_NONE
	bool "None"

config PBL_STACKPROTECTOR_STRONG
	bool "Strong"
	depends on $(cc-option,-fstack-protector-strong)
	depends on PBL_IMAGE
	select STACKPROTECTOR
	help
	  For PBL, This option turns on the "stack-protector" GCC feature. This
	  feature puts, at the beginning of functions, a canary value on
	  the stack just before the return address, and validates
	  the value just before actually returning.  Stack based buffer
	  overflows (that need to overwrite this return address) now also
	  overwrite the canary, which gets detected and the attack is then
	  neutralized via a barebox panic.

	  Functions will have the stack-protector canary logic added in any
	  of the following conditions:

	  - local variable's address used as part of the right hand side of an
	    assignment or function argument
	  - local variable is an array (or union containing an array),
	    regardless of array type or length
	  - uses register local variables

	  The canary is always a fixed value.

config PBL_STACKPROTECTOR_ALL
	bool "PBL"
	depends on $(cc-option,-fstack-protector-strong)
	depends on PBL_IMAGE && COMPILE_TEST
	select STACKPROTECTOR
	help
	  This pushes and verifies stack protector canaries on all functions,
	  even those that don't need it. As this implies injection of a
	  global variable dependency on every function, this option is useful
	  for crashing functions called prior to prerelocation, which lack a
	  __prereloc attribute. This is likely the only upside compared to
	  the strong variant.

endchoice

endmenu

endmenu
```

## lib/Kconfig.kasan
```kconfig
# SPDX-License-Identifier: GPL-2.0-only
# This config refers to the generic KASAN mode.

source "scripts/Kconfig.include"

config HAVE_ARCH_KASAN
	bool

config CC_HAS_KASAN_GENERIC
	def_bool $(cc-option, -fsanitize=kernel-address)

config CC_HAS_WORKING_NOSANITIZE_ADDRESS
	def_bool !CC_IS_GCC || GCC_VERSION >= 80300

config KASAN_GENERIC
	bool

config KASAN
	bool "KASAN: runtime memory debugger"
	depends on HAVE_ARCH_KASAN && CC_HAS_KASAN_GENERIC
	depends on CC_HAS_WORKING_NOSANITIZE_ADDRESS
	select KASAN_GENERIC
	help
	  Enables KASAN (KernelAddressSANitizer) - runtime memory debugger,
	  designed to find out-of-bounds accesses and use-after-free bugs.

	  Before every memory access compiler inserts function call
	  __asan_load*/__asan_store*. These functions performs check
	  of shadow memory.
```

## lib/gui/Kconfig
```kconfig
menu "Library gui routines"

config IMAGE_RENDERER
	bool
	select FILETYPE

if IMAGE_RENDERER

config 2D_PRIMITIVES
       bool

config BMP
	bool "bmp"

config PNG
	bool "png"
	select ZLIB

config IMAGE_RESIZER
	bool "Image resizing support"

if IMAGE_RESIZER

choice
	prompt "Real number arithmetic"

config IMAGE_RESIZE_FIXED_POINT
	bool "Fixed-point arithmetic"
	help
	  This is usable everywhere.

config IMAGE_RESIZE_FLOATING_POINT
	bool "Floating-point arithmetic"
	help
	  This requires compile floating point support. Preferably
	  hardfloats.

endchoice

endif

if PNG

choice
	prompt "PNG Lib"

config LODEPNG
	bool "lodePNG"
	help
	  This PNG library supports most PNG formats.

config PICOPNG
	bool "picoPNG"
	help
	  This PNG library only supports RGBA PNG8 but is much smaller
	  in binary size than lodepng.

endchoice

endif

endif

endmenu
```

## net/Kconfig
```kconfig
# SPDX-License-Identifier: GPL-2.0-only

menuconfig NET
	bool "Networking Support"
	select POLLER

if NET

config NET_ETHADDR_SERIAL
	bool
	prompt "generate Ethernet address from serial number"
	depends on HAVE_DIGEST_SHA256
	help
	  By default, barebox will generate random Ethernet addresses for
	  interfaces that had no explicit Ethernet address set via
	  either board code or NVMEM properties in device tree.

	  Say y here, to generate the random Ethernet address only
	  if no serial number was registered. If barebox_set_serial_number()
	  has been called, its hash will be used instead to generate
	  MAC addresses that are unlikely to change between subsequent
	  runs of barebox.


config NET_NFS
	bool
	prompt "nfs support"

config NET_NETCONSOLE
	bool
	depends on !CONSOLE_NONE
	prompt "network console support"
	help
	  This option adds support for a simple udp based network console.

config NET_RESOLV
	bool
	prompt "dns support"

config NET_IFUP
	default y
	depends on !SHELL_NONE
	bool

config NET_DHCP
	bool
	prompt "dhcp support"

config NET_SNTP
	bool
	prompt "sntp support"

config NET_FASTBOOT
	bool
	select BANNER
	select FASTBOOT_BASE
	prompt "Android Fastboot support"
	help
	  This option adds support for the UDP variant of the Fastboot
	  protocol.

endif
```

## net/lwip/Kconfig
```kconfig
# SPDX-License-Identifier: GPL-2.0-only

config LWIP
	bool "lwIP TCP/IP stack"
	help
	  lwIP is a widely used open-source TCP/IP stack and much
	  more featureful than barebox' normal


if LWIP

config LWIP_OS_FULL
	def_bool n
	help
	  sets NO_SYS == 0, which means a full operating
	  system environment is provided.

config LWIP_EXAMPLE
	bool "lwIP example command"
	depends on COMMAND_SUPPORT

config LWIP_CORE
	def_bool y
	help
	  lwIP core functionality

config LWIP_CORE4
	bool "lwIP IPv4"
	help
	  lwIP IPv4 core support

config LWIP_CORE6
	bool "lwIP IPv6"
	help
	  lwIP IPv6 core support

config LWIP_API
	bool "lwIP sequential/socket API" if COMPILE_TEST
	depends on LWIP_OS_FULL
	help
	  This is selected by code requiring access to sequential
	  and socket APIs.

config LWIP_NETIF
	bool "lwIP generic network interface API" if COMPILE_TEST
	depends on LWIP_OS_FULL
	help
	  lwIP generic network interface functions (TCP/IP, Bridge support,
	  SLIP).

config LWIP_6LOWPAN
	bool "lwIP 6LowPan support" if COMPILE_TEST
	help
	  IPv6 over Low-Power Wireless Personal Area Networks.
	  This currently serves no purpose.

config LWIP_PPP
	bool "lwIP PPP support" if COMPILE_TEST
	depends on LWIP_OS_FULL
	help
	  The Point-to-Point Protocol is a layer 2 protocol for routers
	  to talk to each other.

config LWIP_SNMPv3
	bool "lwIP Simple Network Management Protocol support" if COMPILE_TEST
	help
	  This enabled build of a SNMP (Simple Network Management Protocol) agent,
	  a protocol used widely for networking monitoring.

config LWIP_HTTP
	bool "lwIP HTTP support" if COMPILE_TEST
	help
	  The Hypertext Transfer Protocol (HTTP) is an application layer
	  protocol for data transfer on the World Wide Web. This enables
	  both server and client support.

config LWIP_MAKEFSDATA
	bool "lwIP MAKEFSDATA HTTP server" if COMPILE_TEST
	help
          MAKEFSDATA HTTP server host utility, unsute what that is.

config LWIP_IPERF
	bool "lwIP Iperf server" if COMPILE_TEST
	help
          Iperf is a tool for network performance measurement.

config LWIP_SMTP
	bool "lwIP SMTP client" if COMPILE_TEST
	help
	  The Simple Mail Transfer Protocol (SMTP) is an internet standard
	  communication protocol for electronic mail transmission.
	  This adds client-side support.

config LWIP_SNTP
	bool "lwIP SNTP client" if COMPILE_TEST
	help
	  The Simple Network Time Protocol (SNTP) is a less complex
	  implementation of the Network Time Protocol that does not
	  require storage of state over extended periods of time.
	  This adds client-side support.

config LWIP_MDNS
	bool "lwIP mDNS responder" if COMPILE_TEST
	help
	  multicast DNS allows resolving hostnames to IP address
	  within smaller networks lacking a local name server.

config LWIP_NETBIOS
	bool "lwIP NetBIOS name server" if COMPILE_TEST
	help
	  The Network Basic Input/Output System allows for
	  communication of files and printers over a LAN.

config LWIP_TFTP
	bool "lwIP TFTP server" if COMPILE_TEST
	help
	  The trivial file transfer protocol is a common protocol
	  for network boot on embedded systems. This adds server-side
	  support, not client-side.

config LWIP_MQTT
	bool "lwIP MQTT client" if COMPILE_TEST
	help
	  MQTT is a lightweight publish-subscribe machine-to-machine
	  network protocol.

config LWIP_MBEDTLS
	bool "Mbed-TLS support" if COMPILE_TEST
	help
	  Mbed TLS implements cryptographic primitives, X.509 certificate
	  manipulation and the SSL/TLS and DTLS protocols. This adds
	  the necessary glue for interoperation with lwIP.

endif
```

## scripts/imx/Kconfig
```kconfig
config ARCH_IMX_USBLOADER
	depends on ARCH_MXS || ARCH_IMX || COMPILE_HOST_TOOLS
	bool "imx-usb-loader"
	help
	  imx-usb-loader is a tool to upload and start imximages to an i.MX SoC
	  in ROM boot mode. It requires libusb, so make sure you have the libusb
	  devel package installed on your machine.

if ARCH_IMX_USBLOADER
	config CONFIG_ARCH_IMX_USBLOADER_HIDAPI_SUPPORT
	bool "use HIDAPI backend"
	help
	  imx-usb-loader uses libusb as backend by default, which allows
	  programming USB drivers in userspace. Newer i.MX SoCs register
	  themselves as Human Interface Devices (HID) and are often claimed
	  by a HID kernel driver. On some operating systems, notably macOS,
	  unloading the kernel driver may not be feasible and communicating
	  via the system HID kernel driver may the best choice. If this is
	  the case for you, sat y here to use HIDAPI as backend.
endif
```
