## arch/arm/configs/at91_multi_defconfig
```kconfig
CONFIG_AEABI=y
CONFIG_ARM_OPTIMZED_STRING_FUNCTIONS=y
CONFIG_AT91_MULTI_BOARDS=y
CONFIG_AUTO_COMPLETE=y
CONFIG_BAREBOX_MAX_IMAGE_SIZE=0x40000
CONFIG_BOOTM_INITRD=y
CONFIG_BOOTM_OFTREE_UIMAGE=y
CONFIG_BOOTM_OFTREE=y
CONFIG_BOOTM_SHOW_TYPE=y
# CONFIG_CMD_ARM_CPUINFO is not set
CONFIG_CMD_AT91_BOOT_TEST=y
CONFIG_CMD_BAREBOX_UPDATE=y
# CONFIG_CMD_BOOTU is not set
CONFIG_CMD_CLK=y
CONFIG_CMD_CRC_CMP=y
CONFIG_CMD_CRC=y
CONFIG_CMD_DEFAULTENV=y
CONFIG_CMD_DETECT=y
CONFIG_CMD_DHCP=y
CONFIG_CMD_DMESG=y
CONFIG_CMD_ECHO_E=y
CONFIG_CMD_EDIT=y
CONFIG_CMD_EXPORT=y
CONFIG_CMD_FILETYPE=y
CONFIG_CMD_FLASH=y
CONFIG_CMD_GO=y
CONFIG_CMD_GPIO=y
CONFIG_CMD_I2C=y
CONFIG_CMD_IOMEM=y
CONFIG_CMD_LED_TRIGGER=y
CONFIG_CMD_LED=y
CONFIG_CMD_LET=y
CONFIG_CMDLINE_EDITING=y
CONFIG_CMD_LN=y
CONFIG_CMD_LOADB=y
CONFIG_CMD_LOADENV=y
CONFIG_CMD_MAGICVAR_HELP=y
CONFIG_CMD_MAGICVAR=y
CONFIG_CMD_MD5SUM=y
CONFIG_CMD_MEMINFO=y
CONFIG_CMD_MM=y
CONFIG_CMD_MSLEEP=y
CONFIG_CMD_OF_NODE=y
CONFIG_CMD_OF_PROPERTY=y
CONFIG_CMD_OFTREE=y
CONFIG_CMD_PARTITION=y
CONFIG_CMD_PING=y
CONFIG_CMD_PRINTENV=y
CONFIG_CMD_READF=y
CONFIG_CMD_READLINE=y
CONFIG_CMD_RESET=y
CONFIG_CMD_SAVEENV=y
CONFIG_CMD_SLEEP=y
CONFIG_CMD_TFTP=y
CONFIG_CMD_TIMEOUT=y
CONFIG_CMD_TIME=y
CONFIG_CMD_UIMAGE=y
CONFIG_CONSOLE_ACTIVATE_ALL=y
CONFIG_CONSOLE_ALLOW_COLOR=y
CONFIG_DEFAULT_ENVIRONMENT_GENERIC_NEW=y
CONFIG_DEFAULT_ENVIRONMENT_GENERIC=y
CONFIG_DRIVER_NET_MACB=y
CONFIG_DRIVER_NET_MICREL=y
CONFIG_DRIVER_SPI_ATMEL=y
CONFIG_EEPROM_AT24=y
CONFIG_EXPERIMENTAL=y
CONFIG_FS_FAT_LFN=y
CONFIG_FS_FAT_WRITE=y
CONFIG_FS_FAT=y
CONFIG_FS_NFS=y
CONFIG_FS_TFTP=y
CONFIG_GLOB=y
CONFIG_HUSH_FANCY_PROMPT=y
CONFIG_I2C_GPIO=y
CONFIG_I2C=y
CONFIG_KALLSYMS=y
CONFIG_KEYBOARD_GPIO=y
CONFIG_KEYBOARD_QT1070=y
CONFIG_LED_GPIO_OF=y
CONFIG_LED_GPIO=y
CONFIG_LED_TRIGGERS=y
CONFIG_LED=y
CONFIG_LONGHELP=y
CONFIG_MACH_AT91SAM9X5EK=y
CONFIG_MACH_MICROCHIP_KSZ9477_EVB=y
CONFIG_MALLOC_SIZE=0x0
CONFIG_MALLOC_SIZE=0xa00000
CONFIG_MALLOC_TLSF=y
CONFIG_MCI_ATMEL=y
CONFIG_MCI_MMC_BOOT_PARTITIONS=y
CONFIG_MCI_STARTUP=y
CONFIG_MCI=y
CONFIG_MENU=y
CONFIG_MMU=y
CONFIG_MTD_DATAFLASH=y
CONFIG_MTD_M25P80=y
# CONFIG_MTD_OOB_DEVICE is not set
CONFIG_MTD=y
CONFIG_NAND_ATMEL_PMECC=y
CONFIG_NAND_ATMEL=y
# CONFIG_NAND_ECC_HW_NONE is not set
# CONFIG_NAND_ECC_HW_SYNDROME is not set
# CONFIG_NAND_ECC_SOFT is not set
CONFIG_NAND=y
CONFIG_NET_NETCONSOLE=y
CONFIG_NET_NFS=y
CONFIG_NET_USB_ASIX=y
CONFIG_NET_USB=y
CONFIG_NET=y
CONFIG_OF_BAREBOX_DRIVERS=y
CONFIG_OF_BAREBOX_ENV_IN_FS=y
CONFIG_PROMPT="9G20-EK:"
CONFIG_PROMPT_HUSH_PS2="y"
CONFIG_RELOCATABLE=y
CONFIG_USB_EHCI_ATMEL=y
CONFIG_USB_EHCI=y
CONFIG_USB_HOST=y
CONFIG_USB_STORAGE=y
CONFIG_W1_MASTER_GPIO=y
CONFIG_W1_SLAVE_DS2431=y
CONFIG_W1_SLAVE_DS2433=y
CONFIG_W1=y
```

## arch/arm/configs/microchip_ksz9477_evb_bootstrap_mmc_defconfig
```kconfig
CONFIG_ARCH_SAMA5D3=y
CONFIG_AT91_MULTI_BOARDS=y
CONFIG_MACH_MICROCHIP_KSZ9477_EVB=y
CONFIG_AT91_BOOTSTRAP=y
CONFIG_MALLOC_TLSF=y
CONFIG_RELOCATABLE=y
CONFIG_PROMPT="BOOT.BIN:"
CONFIG_SHELL_NONE=y
# CONFIG_TIMESTAMP is not set
CONFIG_CONSOLE_SIMPLE=y
CONFIG_PBL_CONSOLE=y
CONFIG_DEFAULT_LOGLEVEL=6
CONFIG_DEBUG_LL=y
# CONFIG_SPI is not set
CONFIG_MCI=y
CONFIG_MCI_STARTUP=y
# CONFIG_MCI_WRITE is not set
CONFIG_MCI_ATMEL=y
CONFIG_MFD_SYSCON=y
# CONFIG_FS_RAMFS is not set
# CONFIG_FS_DEVFS is not set
CONFIG_FS_FAT=y
CONFIG_BOOTSTRAP_DEVFS=y
CONFIG_BOOTSTRAP_DISK=y
```

## arch/arm/configs/microchip_ksz9477_evb_first_stage_mmc_defconfig
```kconfig
CONFIG_ARCH_SAMA5D3=y
CONFIG_AT91_MULTI_BOARDS=y
CONFIG_MACH_MICROCHIP_KSZ9477_EVB=y
CONFIG_AT91_BOOTSTRAP=y
CONFIG_BAREBOX_MAX_PBLX_SIZE=0x10000
CONFIG_RELOCATABLE=y
CONFIG_PROMPT="BOOT.BIN:"
CONFIG_SHELL_NONE=y
# CONFIG_TIMESTAMP is not set
CONFIG_PBL_CONSOLE=y
CONFIG_DEFAULT_LOGLEVEL=6
CONFIG_MCI=y
CONFIG_MCI_STARTUP=y
# CONFIG_MCI_WRITE is not set
CONFIG_MCI_ATMEL=y
CONFIG_MFD_SYSCON=y
# CONFIG_FS_RAMFS is not set
# CONFIG_FS_DEVFS is not set
CONFIG_FS_FAT=y
CONFIG_FS_FAT_LFN=y
CONFIG_BOOTSTRAP_DEVFS=y
CONFIG_BOOTSTRAP_DISK=y
```

## arch/arm/configs/nintendo_defconfig
```kconfig
CONFIG_ARCH_NINTENDO=y
CONFIG_NINTENDO_INIT=y
CONFIG_MACH_NINTENDO_GBA=y
CONFIG_MACH_NINTENDO_GBA_GAMEPAK=y
CONFIG_MACH_NINTENDO_GBA_MULTIBOOT=y
CONFIG_ENVIRONMENT_VARIABLES=y
CONFIG_GLOBALVAR=y
CONFIG_NVVAR=y
CONFIG_IMAGE_COMPRESSION_NONE=y
CONFIG_STACK_SIZE=0x2000
CONFIG_MALLOC_SIZE=0x8000
CONFIG_RELOCATABLE=y
CONFIG_SHELL_NONE=y
# CONFIG_ERRNO_MESSAGES is not set
# CONFIG_BOOTM is not set
CONFIG_CONSOLE_SIMPLE=y
CONFIG_PBL_CONSOLE=y
CONFIG_ENV_HANDLING=y
# CONFIG_CMD_ARM_CPUINFO is not set
# CONFIG_CMD_DEVINFO is not set
# CONFIG_CMD_DRVINFO is not set
# CONFIG_CMD_HELP is not set
# CONFIG_CMD_VERSION is not set
# CONFIG_CMD_BOOTU is not set
# CONFIG_CMD_MOUNT is not set
# CONFIG_CMD_UMOUNT is not set
# CONFIG_CMD_CAT is not set
# CONFIG_CMD_CD is not set
# CONFIG_CMD_CP is not set
# CONFIG_CMD_MKDIR is not set
# CONFIG_CMD_PWD is not set
# CONFIG_CMD_RM is not set
# CONFIG_CMD_RMDIR is not set
# CONFIG_CMD_FALSE is not set
# CONFIG_CMD_TRUE is not set
# CONFIG_CMD_CLEAR is not set
# CONFIG_CMD_ECHO is not set
CONFIG_CMD_FBTEST=y
# CONFIG_CMD_MD is not set
# CONFIG_CMD_MEMCMP is not set
# CONFIG_CMD_MEMCPY is not set
# CONFIG_CMD_MEMSET is not set
# CONFIG_CMD_MW is not set
CONFIG_VIDEO=y
CONFIG_FRAMEBUFFER_CONSOLE=y
CONFIG_DRIVER_VIDEO_GBA=y
CONFIG_CLOCKSOURCE_NINTENDO_GBA=y
CONFIG_DEV_MEM=y
# CONFIG_PINCTRL is not set
```

## arch/arm/configs/sama5d27_som1_ek_bootstrap_mmc_defconfig
```kconfig
CONFIG_ARCH_SAMA5D2=y
CONFIG_AT91_MULTI_BOARDS=y
CONFIG_MACH_SAMA5D27_SOM1=y
CONFIG_AT91_LOAD_BAREBOX_SRAM=y
# CONFIG_GLOBALVAR is not set
CONFIG_BAREBOX_MAX_PBL_SIZE=0x10000
CONFIG_BAREBOX_MAX_BARE_INIT_SIZE=0x10000
CONFIG_RELOCATABLE=y
CONFIG_PROMPT="BOOT.BIN:"
CONFIG_SHELL_SIMPLE=y
# CONFIG_TIMESTAMP is not set
# CONFIG_BOOTM is not set
CONFIG_PBL_CONSOLE=y
CONFIG_PARTITION=y
# CONFIG_ENV_HANDLING is not set
CONFIG_DEFAULT_LOGLEVEL=6
CONFIG_DEBUG_LL=y
# CONFIG_SPI is not set
CONFIG_MFD_SYSCON=y
# CONFIG_FS_RAMFS is not set
# CONFIG_FS_DEVFS is not set
```

## arch/arm/mach-nintendo/Kconfig
```kconfig
if ARCH_NINTENDO

config ARCH_TEXT_BASE
	hex
	default 0x02000000 if MACH_NINTENDO_GBA_MULTIBOOT
	default 0x08000000

config NINTENDO_INIT
	bool "Nintendo init application"
	select COMMAND_SUPPORT

config ARCH_NINTENDO_GBA
	bool
	select CPU_ARM7TDMI
	select CPU_32v4T_NO_CACHES
	select HAS_DEBUG_LL

config MACH_NINTENDO_GBA
	bool "Nintendo Game boy Advance"
	select ARCH_NINTENDO_GBA
	select OFDEVICE

endif
```

## arch/mips/mach-malta/Kconfig
```kconfig
if MACH_MIPS_MALTA

config BOARD_QEMU_MALTA
	bool "qemu malta"
	select HAVE_PBL_IMAGE
	select HAVE_IMAGE_COMPRESSION
	select POWER_RESET_SYSCON
	select HAS_NMON

endif
```

## drivers/hwspinlock/Kconfig
```kconfig
menu "Hardware Spinlock Support"

config HWSPINLOCK
	bool

config HWSPINLOCK_STM32
	bool "Enable Hardware Spinlock support for STM32"
	depends on ARCH_STM32MP
	select HWSPINLOCK
	default STM32_REMOTEPROC
	help
	  Enable hardware spinlock support in STM32MP. This is useful if
	  you're using barebox to load the microcontroller firmware and the
	  microcontroller needs access to hardware peripherals used by barebox
	  as well.

endmenu
```

## drivers/mailbox/Kconfig
```kconfig
menuconfig MAILBOX
	bool "Mailbox Hardware Support"
	help
	  Mailbox is a framework to control hardware communication between
	  on-chip processors through queued messages.
	  Say Y if your platform supports hardware mailboxes.
```

## drivers/misc/Kconfig
```kconfig
#
# Misc strange devices
#

menu "Misc devices"

config JTAG
	tristate "JTAG Bitbang driver"
	depends on GENERIC_GPIO
	help
	  Controls JTAG chains connected to I/O pins

config SRAM
	bool "Generic SRAM driver"
	help
	  This driver adds support for memory mapped SRAM.

config STATE_DRV
	tristate "state driver"
	depends on OFDEVICE
	depends on STATE

config DEV_MEM
        bool "Generic memory I/O device (/dev/mem)"

config UBOOTVAR
	bool "U-Boot environment storage"
	help
	  This driver exposes U-Boot environment variable storage as a
	  single mmap-able device, hiding various low-level details
	  such as:
	      - Preamble format differences
	      - Read/write logic in presence of redundant partition

	  While it can be used standalone, it is best when coupled
	  with corresponding filesystem driver.

config PSCI_CLIENT
	bool "PSCI client driver"
	depends on CPU_32v7 || CPU_64v8
	select ARM_SMCCC

endmenu
```

## drivers/net/designware/Kconfig
```kconfig
config DRIVER_NET_DESIGNWARE
	bool "Designware Universal MAC ethernet platform support"
	depends on HAS_DMA
	select PHYLIB
	help
	  This option enables support for the Synopsys
	  Designware Core Univesal MAC 10M/100M/1G ethernet IP.

if DRIVER_NET_DESIGNWARE

config DRIVER_NET_DESIGNWARE_DWMAC1000
	bool

config DRIVER_NET_DESIGNWARE_DWMAC4
	bool

config DRIVER_NET_DESIGNWARE_GENERIC
	bool "Designware Universal MAC ethernet generic driver"
	select DRIVER_NET_DESIGNWARE_DWMAC1000
	help
	  This option enables support for the Synopsys
	  Designware Core Univesal MAC 10M/100M/1G ethernet IP on SoCFPGA.

config DRIVER_NET_DESIGNWARE_SOCFPGA
	bool "Designware Universal MAC ethernet driver for SoCFPGA platforms"
	depends on ARCH_SOCFPGA
	select MFD_SYSCON
	select RESET_CONTROLLER
	select DRIVER_NET_DESIGNWARE_DWMAC1000
	help
	  This option enables support for the Synopsys
	  Designware Core Univesal MAC 10M/100M/1G ethernet IP on SoCFPGA.

config DRIVER_NET_DESIGNWARE_STM32
	bool "Designware Ethernet QOS driver for STM32"
	select MFD_SYSCON
	select DRIVER_NET_DESIGNWARE_DWMAC4
	help
	  This option enables support for the Synopsys Designware Ethernet QOS
	  IP on STM32MP family of CPUs.

config DRIVER_NET_DESIGNWARE_TEGRA186
	bool "Designware Ethernet QOS driver for Tegra186"
	select RESET_CONTROLLER
	select DRIVER_NET_DESIGNWARE_DWMAC4
	help
	  This option enables support for the Synopsys Designware Ethernet QOS
	  IP on Tegra186 family of CPUs.

endif
```

## drivers/power/reset/Kconfig
```kconfig
# SPDX-License-Identifier: GPL-2.0-only
#

config REBOOT_MODE
	bool

config SYSCON_REBOOT_MODE
	bool "Generic SYSCON regmap reboot mode driver"
	depends on OFDEVICE
	depends on MFD_SYSCON
	select REBOOT_MODE
	help
	  Say y here will enable reboot mode driver. This will
	  get reboot mode arguments and store it in SYSCON mapped
	  register, then the bootloader can read it to take different

config NVMEM_REBOOT_MODE
	bool "Generic NVMEM reboot mode driver"
	depends on OFDEVICE
	select REBOOT_MODE
	help
	  Say y here will enable reboot mode driver. This will
	  get reboot mode arguments and store it in a NVMEM cell,
	  then the bootloader can read it and take different
	  action according to the mode.
```

## drivers/reset/Kconfig
```kconfig
config ARCH_HAS_RESET_CONTROLLER
	bool

menuconfig RESET_CONTROLLER
	bool "Reset Controller Support"
	default y if ARCH_HAS_RESET_CONTROLLER
	help
	  Generic Reset Controller support.

	  This framework is designed to abstract reset handling of devices
	  via GPIOs or SoC-internal reset controller modules.

	  If unsure, say no.

if RESET_CONTROLLER

config RESET_IMX7
	bool "i.MX7 Reset Driver"
	default SOC_IMX7D
	select MFD_SYSCON
	help
	  This enables the reset controller driver for i.MX7 SoCs.

config RESET_STM32F
	bool "STM32F Reset Driver"
	help
	  This enables the reset controller driver for STM32F MCUs.

config RESET_STM32MP
	bool "STM32MP Reset Driver"
	default ARCH_STM32MP
	help
	  This enables the reset controller driver for STM32MP SoCs.

endif
```

## drivers/sound/Kconfig
```kconfig
# SPDX-License-Identifier: GPL-2.0-only
menuconfig SOUND
	bool "Sound drivers"
	select POLLER
	help
	  Say Y here for sound support. At the moment that's just beep tones.
	  Tones are played asynchronously in a poller. Check the beep command
	  for how to exercise the API.

if SOUND

config SOUND_SDL
	bool "SDL sound driver for sandbox"
	depends on SANDBOX && OFDEVICE
	select SDL

config PWM_BEEPER
	bool "PWM beeper support"
	depends on PWM && OFDEVICE
	help
	  Say Y here to get support for PWM based beeper devices.

config GPIO_BEEPER
	bool "GPIO beeper support"
	depends on GPIOLIB && OFDEVICE
	help
	  Say Y here to get support for GPIO based beeper devices.

config SOUND_ROCKCHIP_I2S
	bool "Rockchip I2S Device Driver"
	select SND_SOC
	help
	  Say Y if you want to add support for I2S driver for
	  Rockchip I2S device.

config SYNTH_SQUARES
	bool "Synthesize square waves only"
	help
	  For beeping on PCM sound cards, barebox needs to synthesize samples,
	  which can take too much poller time for crisp playback and/or quick
	  booting. If your playback stutters, say Y here. This will have all
	  synthesizers output a gain-adjusted square wave instead, which is
	  less time-consuming to compute.

endif
```
